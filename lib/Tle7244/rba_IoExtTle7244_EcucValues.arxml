AUTOSAR XML (schema 4-1-1)
package /RB/UBK/Project/EcucModuleConfigurationValuess
  module config Pwm
    PwmChannelConfigSet
      3 x PwmChannel, all with PwmRbTimebase=PWM_TIME, PwmRbTimerUnit=GTM_ATOM:
        O_T_RL{06..08}
    PwmOptionalApi:
      PwmDeInitApi = true
      PwmGetOutputStateApi = true
      PwmRbMedc17LegacyApi = true
      PwmSetDutyCycleApi = true
      PwmSetOutputToIdleApi = true
      PwmSetPeriodAndDutyApi = true
      PwmVersionInfoApi = true
  module config rba_Gtm
    rba_Gtm_Config
      3 x rba_Gtm_Tom:
        O_T_RL06: rba_Gtm_Tom_2_Module=ATOM4, rba_Gtm_Tom_3_Channel=CH3
        O_T_RL07: rba_Gtm_Tom_2_Module=ATOM1, rba_Gtm_Tom_3_Channel=CH2
        O_T_RL08: rba_Gtm_Tom_2_Module=ATOM4, rba_Gtm_Tom_3_Channel=CH7
  module config rba_IoExtTle7244
    rba_IoExtTle7244_General:
      rba_IoExtTle7244_DevErrorDetect = true
      rba_IoExtTle7244_DiagApi = true
      rba_IoExtTle7244_DioApi = true
      rba_IoExtTle7244_PwmApi = true
      rba_IoExtTle7244_VersionInfoApi = true
    rba_IoExtTle7244_ConfigSet
      3 x rba_IoExtTle7244_SignalPwm, all with rba_IoExtTle7244_ChannelClass=PWM_VARIABLE_PERIOD:
        O_T_RL06: rba_IoExtTle7244_ConnectedTo=PWM_10_06
        O_T_RL07: rba_IoExtTle7244_ConnectedTo=PWM_10_05
        O_T_RL08: rba_IoExtTle7244_ConnectedTo=PWM_02_11
  module config rba_IoSigPwm
    rba_IoSigPwm_ConfigSet
      3 x rba_IoSigPwm_Signal, all with rba_IoSigPwm_Calibratable=true, rba_IoSigPwm_ChannelClass=PWM_VARIABLE_PERIOD, rba_IoSigPwm_ClockBase=PWM_TIME, rba_IoSigPwm_InitDutyCycle=0, rba_IoSigPwm_InitPeriod=10000, rba_IoSigPwm_InitStrategy=AnyReset, rba_IoSigPwm_MaxPeriod=1000000, rba_IoSigPwm_MinPeriod=5000, rba_IoSigPwm_OutDiagCurrent=true, rba_IoSigPwm_OutProtectStrategy=SwitchOff, rba_IoSigPwm_Polarity=PWM_HIGH:
        O_T_RL06: rba_IoSigPwm_0CustSpecName=O_T_RL06, rba_IoSigPwm_CalibAlterText=O_T_RL06, rba_IoSigPwm_ConnectedTo=TLE7244_01_02
          rba_IoSigPwm_Diagnosis: rba_IoSigPwm_DiagTestPulse=true, rba_IoSigPwm_DiagTestPulseDurActive=5, rba_IoSigPwm_DiagTestPulseDurIdle=65
        O_T_RL07: rba_IoSigPwm_0CustSpecName=O_T_RL07, rba_IoSigPwm_CalibAlterText=O_T_RL07, rba_IoSigPwm_ConnectedTo=TLE7244_01_03
          rba_IoSigPwm_Diagnosis: rba_IoSigPwm_DiagTestPulse=true, rba_IoSigPwm_DiagTestPulseDurActive=5, rba_IoSigPwm_DiagTestPulseDurIdle=65
        O_T_RL08: rba_IoSigPwm_0CustSpecName=O_T_RL08, rba_IoSigPwm_CalibAlterText=O_T_RL08, rba_IoSigPwm_ConnectedTo=TLE7244_01_04
          rba_IoSigPwm_Diagnosis: rba_IoSigPwm_DiagTestPulse=true, rba_IoSigPwm_DiagTestPulseDurActive=5, rba_IoSigPwm_DiagTestPulseDurIdle=65
    rba_IoSigPwm_General: rba_IoSigPwm_DevErrorDetect=true, rba_IoSigPwm_RequestHandling=Strict, rba_IoSigPwm_VersionInfoApi=false
