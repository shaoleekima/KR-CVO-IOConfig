AUTOSAR XML (schema 4-2-2)
package /RB/RBA/rba_IoExtTle7244/EcucModuleDefs
  module definition rba_IoExtTle7244 [0..1]: category=VENDOR_SPECIFIC_MODULE_DEFINITION, post-build-variant-support=true, refined-module-def=rba_IoExtTle7244, variants post-build/pre-compile  # I/O External Device: TLE7244 | Configuration for the module IoExtTle7244
    container rba_IoExtTle7244_ConfigSet [0..1]: multiplicity set at pre-compile  # Configuration data set | Defines one data set of post-build configuration. Which of these data sets is actually active is controlled by EcuM. Data sets can only be switched at initialization time.
      container rba_IoExtTle7244_SignalCdrv [0..*]: multiplicity set at pre-compile, post-build-variant-multiplicity=true  # Signal Cdrv | Configuration of a single Complex Driver signal. Used to reserve TLE7244 powerstages for signals which can not be controlled via DIO or PWM API of TLE7244.
        string rba_IoExtTle7244_ConnectedTo: origin=RB:0.1.0:2016-12-16, post-build-variant-value=true, set at pre-compile  # ConnectedTo | Specifies to which port and which pin on the µC this signal is connected to. The general scheme of fully qualified pin specifications to be used here is PORT_<Port Index>_<Pin>. Example: PORT_14_04 <Device Or Port Index> specifies the zero-based index of the µC port over which this signal is transferred. <Pin> always specifies the index of the particular pin on the given port which transports this signal. The port and pin numbering schemes are µC specific. Only one connector per signal may be specified for now. In the future it might be sensible to allow multiple connectors for output signals. This would enable the parallel and synchronous output of a signal via two pins. For all CDRV signals this tag has to be configured since it is not possible to control CDRV signals through SPI
        string rba_IoExtTle7244_Connector [1..*]: multiplicity set at pre-compile, origin=RB:0.1.0:2014-11-20, post-build-variant-multiplicity=true, post-build-variant-value=true, set at pre-compile, max-length=32, min-length=1, regular-expression=TLE7244_\d{2}_\d{2}  # Connector | Specifies to which device and which stage on this device this signal is connected to. The general scheme of fully qualified stage specifications to be used here is <DeviceType>_<DeviceIdx>_<StageIdx>. If more than one connection is configured, then the corresponding pins are driven in parallel (only possible for output signals on the same device, additionally HW-specific restrictions may apply).
        string rba_IoExtTle7244_CustSpecName [0..1]: multiplicity set at pre-compile, origin=RB:0.1.0:2014-11-20, post-build-variant-multiplicity=true, post-build-variant-value=true, set at pre-compile, max-length=32, min-length=1  # Customer Specific Name | Customer-specific name of this signal. If present, this name is taken instead of the signal's "normal" short name for documentation and logging purposes.
        function name rba_IoExtTle7244_NotificationBeginTx [0..1]: multiplicity set at pre-compile, origin=RB:0.1.0:2014-11-20, post-build-variant-multiplicity=true, post-build-variant-value=true, set at pre-compile  # Tx begin notification callback | Specifies the name of the callback function that will be called to notify the Complex Device Driver after validating the diagnosis information..
        string rba_IoExtTle7244_NotificationHeader [0..1]: multiplicity set at pre-compile, origin=RB:0.1.0:2014-11-20, post-build-variant-multiplicity=true, post-build-variant-value=true, set at pre-compile, max-length=32, min-length=1  # Module callback header | Name of the header file of the complex device driver that provides the declaration of the notification callback functions.
        boolean rba_IoExtTle7244_OutDiagCurrent [0..1]: multiplicity set at pre-compile, origin=RB:0.1.0:2014-11-20, post-build-variant-multiplicity=true, post-build-variant-value=true, set at pre-compile, default-value=true  # Output diagnostic current | Enables/disables diagnostic current of power stages. The diagnostic current is necessary for power stages to distinguish between different error type like SCB, SCG and OL. For some use cases the diagnostic current must be disabled.
        enumeration rba_IoExtTle7244_OutProtectStrategy [0..1]: multiplicity set at pre-compile, origin=RB:0.1.0:2014-11-20, post-build-variant-multiplicity=true, post-build-variant-value=true, set at pre-compile, default-value=SwitchOff  # Output protection strategy | Defines the behaviour of the power stage in case of overload (only relevant for output signals). Possible reactions are automatic switch-off or current limitation. Remark: This configuration item exists due to interface requirements of CDRV - the TLE7244 has Switch-off mode only as the protection strategy in case of over load
          SwitchOff  # Switch-off
          CurrentLimit  # Current limitation
          NoProtect  # No protection
      container rba_IoExtTle7244_SignalDio [0..*]: multiplicity set at pre-compile, post-build-variant-multiplicity=true  # Signal Dio | Configuration of DIO output signal
        string rba_IoExtTle7244_ConnectedTo [0..1]: multiplicity set at pre-compile, origin=RB:0.1.0:2014-11-20, post-build-variant-multiplicity=true, post-build-variant-value=true, set at pre-compile  # ConnectedTo | Specifies to which port and which pin on the µC this signal is connected to. The general scheme of fully qualified pin specifications to be used here is DIO_<Port Index>_<Pin>. Example: DIO_14_04 <Device Or Port Index> specifies the zero-based index of the µC port over which this signal is transferred. <Pin> always specifies the index of the particular pin on the given port which transports this signal. The port and pin numbering schemes are µC specific. Only one connector per signal may be specified for now. In the future it might be sensible to allow multiple connectors for output signals. This would enable the parallel and synchronous output of a signal via two pins. If this tag is not configured, then the powerstage will be controlled through SPI
        string rba_IoExtTle7244_Connector [1..*]: multiplicity set at pre-compile, origin=RB:0.1.0:2014-11-20, post-build-variant-multiplicity=true, post-build-variant-value=true, set at pre-compile, with-auto=true, max-length=32, min-length=1, regular-expression=TLE7244_\d{2}_\d{2}  # Connector | Specifies to which device and which stage on this device this signal is connected to. The general scheme of fully qualified stage specifications to be used here is <DeviceType>_<DeviceIdx>_<StageIdx>. If more than one connection is configured, then the corresponding pins are driven in parallel (only possible for output signals on the same device, additionally HW-specific restrictions may apply).
        string rba_IoExtTle7244_CustSpecName [0..1]: multiplicity set at pre-compile, origin=RB:0.1.0:2014-11-20, post-build-variant-multiplicity=true, post-build-variant-value=true, set at pre-compile, with-auto=true, max-length=32, min-length=1  # Customer Specific Name | Customer-specific name of this signal. If present, this name is taken instead of the signal's "normal" short name for documentation and logging purposes.
        integer rba_IoExtTle7244_DiagTestPulseDurActive [0..1]: multiplicity set at pre-compile, origin=RB:0.1.0:2014-11-20, post-build-variant-multiplicity=true, post-build-variant-value=true, set at pre-compile, with-auto=true  # Test pulse duration (active) [us] | Specifies the duration of test pulses which temporarily set the powerstage output to "active" state. This value will also be used by power stages to determine if a specific error is testable without using test pulses. The unit of this setting is microseconds.
        integer rba_IoExtTle7244_DiagTestPulseDurIdle [0..1]: multiplicity set at pre-compile, origin=RB:0.1.0:2014-11-20, post-build-variant-multiplicity=true, post-build-variant-value=true, set at pre-compile, with-auto=true  # Test pulse duration (idle) [us] | Specifies the duration of test pulses which temporarily set the powerstage output to "idle" state. This value will also be used by power stages to determine if a specific error is testable without using test pulses. The unit of this setting is microseconds.
        enumeration rba_IoExtTle7244_Direction: {Input, Output}, origin=RB:0.1.0:2014-11-20, post-build-variant-value=true, set at pre-compile, with-auto=true  # Direction | Direction of this signal. In case of a bidirectional signal this is the initial direction. Remark: This configuration item exists due to interface requirements of IoSigDio - the TLE7244 has OUTPUT pins only.
        boolean rba_IoExtTle7244_DirectionChangeable: origin=RB:0.1.0:2014-11-20, post-build-variant-value=true, set at pre-compile, with-auto=true  # Direction changeable | Specifies whether the direction of the signal can be changed during runtime (bidirectional signals). Remark: This configuration item exists due to interface requirements of IoSigDio - the TLE7244 has OUTPUT pins only.
        enumeration rba_IoExtTle7244_InitState [0..1]: {Active, Idle}, multiplicity set at pre-compile, origin=RB:0.1.0:2014-11-20, post-build-variant-multiplicity=true, post-build-variant-value=true, set at pre-compile, with-auto=true, default-value=Idle  # Init state | Level of this signal after initialization (active or idle ). This setting is only relevant for output signals.
        enumeration rba_IoExtTle7244_InitStrategy [0..1]: multiplicity set at pre-compile, origin=RB:0.1.0:2014-11-20, post-build-variant-multiplicity=true, post-build-variant-value=true, set at pre-compile, with-auto=true, default-value=AnyReset  # Init strategy | Defines the (re-) initialization strategy of this signal. This setting is only relevant for output signals. Standard behaviour is that (re-) initialization takes place with any kind of reset. Not all hardware environments support all sorts of re-initialization strategies.
          AnyReset  # Any reset
          PwrOnReset  # Power-on reset
        boolean rba_IoExtTle7244_OutDiagCurrent [0..1]: multiplicity set at pre-compile, origin=RB:0.1.0:2014-11-20, post-build-variant-multiplicity=true, post-build-variant-value=true, set at pre-compile, with-auto=true, default-value=true  # Output diagnostic current | Enables/disables diagnostic current of power stages. The diagnostic current is necessary for power stages to distinguish between different error type like SCB, SCG and OL. For some use cases the diagnostic current must be disabled.
        enumeration rba_IoExtTle7244_OutProtectStrategy [0..1]: multiplicity set at pre-compile, origin=RB:0.1.0:2014-11-20, post-build-variant-multiplicity=true, post-build-variant-value=true, set at pre-compile, with-auto=true, default-value=SwitchOff  # Output protection strategy | Defines the behaviour of the power stage in case of overload (only relevant for output signals). Possible reactions are automatic switch-off or current limitation. Remark: This configuration item exists due to interface requirements of DIO - the TLE7244 has Switch-off mode only as the protection strategy in case of over load
          SwitchOff  # Switch-off
          CurrentLimit  # Current limitation
          NoProtect  # No protection
      container rba_IoExtTle7244_SignalPwm [0..*]: multiplicity set at pre-compile, post-build-variant-multiplicity=true  # Signal Pwm | Configuration of a single pwm output signal.
        enumeration rba_IoExtTle7244_ChannelClass: origin=RB:0.1.0:2014-11-20, post-build-variant-value=true, set at pre-compile, with-auto=true  # Channel Class | Defines whether the period can be changed in addition to the duty cycle. If only the duty cycle can be changed it also defines whether the period can be shifted.
          PWM_VARIABLE_PERIOD  # Variable Period
          PWM_FIXED_PERIOD  # Fixed Period
          PWM_FIXED_PERIOD_SHIFTED  # Fixed Period Shifted
        enumeration rba_IoExtTle7244_ClockBase [0..1]: multiplicity set at pre-compile, origin=RB:0.1.0:2014-11-20, post-build-variant-multiplicity=true, post-build-variant-value=true, set at pre-compile, with-auto=true, default-value=PWM_TIME  # Clock Base | Defines the clock source for Pwm channel: PWM_TIME : means the channel output clock source is a time base clock. PWM_ANGLE : means the channel output clock source is the angle clock from EPM
          PWM_TIME  # Time Clock
          PWM_ANGLE  # Angle Clock
        string rba_IoExtTle7244_ConnectedTo: origin=RB:0.1.0:2014-11-20, post-build-variant-value=true, set at pre-compile  # ConnectedTo | Specifies to which port and which pin on the µC this signal is connected to. The general scheme of fully qualified pin specifications to be used here is PWM_<Port Index>_<Pin>. Example: PWM_14_04 <Device Or Port Index> specifies the zero-based index of the µC port over which this signal is transferred. <Pin> always specifies the index of the particular pin on the given port which transports this signal. The port and pin numbering schemes are µC specific. Only one connector per signal may be specified for now. In the future it might be sensible to allow multiple connectors for output signals. This would enable the parallel and synchronous output of a signal via two pins. For all PWM signals this tag has to be configured since it is not possible to control PWM signals through SPI
        string rba_IoExtTle7244_Connector [1..*]: multiplicity set at pre-compile, origin=RB:0.1.0:2014-11-20, post-build-variant-multiplicity=true, post-build-variant-value=true, set at pre-compile, with-auto=true, max-length=32, min-length=1, regular-expression=TLE7244_\d{2}_\d{2}  # Connector | Specifies to which device and which stage on this device this signal is connected to. The general scheme of fully qualified stage specifications to be used here is <DeviceType>_<DeviceIdx>_<StageIdx>. If more than one connection is configured, then the corresponding pins are driven in parallel (only possible for output signals on the same device, additionally HW-specific restrictions may apply).
        string rba_IoExtTle7244_CustSpecName [0..1]: multiplicity set at pre-compile, origin=RB:0.1.0:2014-11-20, post-build-variant-multiplicity=true, post-build-variant-value=true, set at pre-compile, with-auto=true, max-length=32, min-length=1  # Customer-specific name | Customer-specific name of this signal. If present, this name is taken instead of the signal's "normal" short name for documentation and logging purposes.
        integer rba_IoExtTle7244_DiagTestPulseDurActive [0..1]: multiplicity set at pre-compile, origin=RB:0.1.0:2014-11-20, post-build-variant-multiplicity=true, post-build-variant-value=true, set at pre-compile, with-auto=true  # Test pulse duration (active) [us] | Specifies the duration of test pulses which temporarily set the powerstage output to "active" state. This value will also be used by power stages to determine if a specific error is testable without using test pulses. The unit of this setting is microseconds.
        integer rba_IoExtTle7244_DiagTestPulseDurIdle [0..1]: multiplicity set at pre-compile, origin=RB:0.1.0:2014-11-20, post-build-variant-multiplicity=true, post-build-variant-value=true, set at pre-compile, with-auto=true  # Test pulse duration (idle) [us] | Specifies the duration of test pulses which temporarily set the powerstage output to "idle" state. This value will also be used by power stages to determine if a specific error is testable without using test pulses. The unit of this setting is microseconds.
        integer rba_IoExtTle7244_InitDutyCycle: 0..32768, origin=RB:0.1.0:2014-11-20, post-build-variant-value=true, set at pre-compile, with-auto=true  # Init duty cycle | Duty cycle of this signal after initialization (0x0000 = 0% ... 0x8000 = 100%).
        integer rba_IoExtTle7244_InitPeriod: 0.., origin=RB:0.1.0:2014-11-20, post-build-variant-value=true, set at pre-compile, with-auto=true  # Init Period | Period of the signal after initialization.
        enumeration rba_IoExtTle7244_InitStrategy [0..1]: multiplicity set at pre-compile, origin=RB:0.1.0:2014-11-20, post-build-variant-multiplicity=true, post-build-variant-value=true, set at pre-compile, with-auto=true  # Init strategy | Defines the (re-) initialization strategy of this signal. This setting is only relevant for output signals. Standard behaviour is that (re-) initialization takes place with any kind of reset. Not all hardware environments support all sorts of re-initialization
          AnyReset  # Any reset
          PwrOnReset  # Power-on reset
        integer rba_IoExtTle7244_MaxPeriod [0..1]: 0.., multiplicity set at pre-compile, origin=RB:0.1.0:2014-11-20, post-build-variant-multiplicity=true, post-build-variant-value=true, set at pre-compile, with-auto=true, default-value=0  # Max Period | Maximum period of this signal (usec) if class Variable Period is set.
        integer rba_IoExtTle7244_MinPeriod [0..1]: 0.., multiplicity set at pre-compile, origin=RB:0.1.0:2014-11-20, post-build-variant-multiplicity=true, post-build-variant-value=true, set at pre-compile, with-auto=true, default-value=0  # Min Period | Minimum period of this signal (usec) if class Variable Period is set.
        string rba_IoExtTle7244_Notification [0..1]: multiplicity set at pre-compile, origin=RB:0.1.0:2014-11-20, post-build-variant-multiplicity=true, post-build-variant-value=true, set at pre-compile, with-auto=true, max-length=32, min-length=1, regular-expression=[A-Za-z_][A-Za-z_]*  # Notification Callback | Defines the name of the optional callback function for this channel.
        boolean rba_IoExtTle7244_OutDiagCurrent [0..1]: multiplicity set at pre-compile, origin=RB:0.1.0:2014-11-20, post-build-variant-multiplicity=true, post-build-variant-value=true, set at pre-compile, with-auto=true, default-value=true  # Output diagnostic current | Enables/disables diagnostic current of power stages. The diagnostic current is necessary for power stages to distinguish between different error type like SCB, SCG and OL. For some use cases the diagnostic current must be disabled.
        enumeration rba_IoExtTle7244_OutProtectStrategy [0..1]: multiplicity set at pre-compile, origin=RB:0.1.0:2014-11-20, post-build-variant-multiplicity=true, post-build-variant-value=true, set at pre-compile, with-auto=true, default-value=SwitchOff  # Output protection strategy | Defines the behaviour of the power stage in case of overload (only relevant for output signals). Possible reactions are automatic switch-off or current limitation. Remark: This configuration item exists due to interface requirements of IoSigPwm - the TLE7244 has Switch-off mode only as the protection strategy in case of over load
          SwitchOff  # Switch-off
          CurrentLimit  # Current limitation
          NoProtect  # No protection
        enumeration rba_IoExtTle7244_Polarity: origin=RB:0.1.0:2014-11-20, post-build-variant-value=true, set at pre-compile, with-auto=true  # Polarity | Defines the starting polarity of each PWM signal Active State: Signal output is in active state at the beginning of the cycle Idle State: Signal output is in idle state at the beginning of the cycle It shall be set to Active State for normal use cases. If set to Idle State, all states are interpreted in negative logic. Use this only in exceptional cases, e.g. if you use an inverting actuator which is in active state when not being actuated, like an active closing valve.
          PWM_HIGH  # Active State
          PWM_LOW  # Idle State
    container rba_IoExtTle7244_General  # General settings | Configuration of the general aspects of the module Tle7244
      boolean rba_IoExtTle7244_DevErrorDetect: origin=RB:0.1.0:2014-11-20, set at pre-compile  # Development error detection | Enables/disables the detection and notification of development errors. If this parameter is enabled, then extended error checking is performed during runtime; any errors detected by these checks are reported to the Dem module. This feature should be switched off in series software.
      boolean rba_IoExtTle7244_DiagApi: origin=RB:0.1.0:2014-11-20, set at pre-compile  # Diagnosis API | Enables/disables the Diagnosis API. This functionality is only necessary for projects with external devices that diagnosis.
      boolean rba_IoExtTle7244_DioApi: origin=RB:0.1.0:2014-11-20, set at pre-compile  # DIO API | Enables/disables the Dio API. This functionality is only necessary for projects with external devices that support Dio signals.
      boolean rba_IoExtTle7244_PwmApi: origin=RB:0.1.0:2014-11-20, set at pre-compile  # PWM API | Enables/disables the PWM API. This functionality is only necessary for projects with external devices that support PWM signals.
      boolean rba_IoExtTle7244_VersionInfoApi: origin=RB:0.1.0:2014-11-20, set at pre-compile  # Version information API | Enables/disables the GetVersionInfo() API. This functionality can be used e.g. for providing version information to test equipment.
