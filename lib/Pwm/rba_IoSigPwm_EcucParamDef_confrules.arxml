AUTOSAR XML (schema 4-2-2)
package /RB/RBA/rba_IoSigPwm/EcucModuleDefs
  module definition rba_IoSigPwm [0..1]: category=VENDOR_SPECIFIC_MODULE_DEFINITION, post-build-variant-support=true, variants pre-compile  # I/O Signals: Pulse width modulation | Configuration of all PWM output signals of an ECU.
    container rba_IoSigPwm_ConfigSet  # Configuration data set | Defines one data set of post-build configuration. Which of these data sets is actually active is controlled by EcuM. Data sets can only be switched at initialization time.
      container rba_IoSigPwm_Signal [0..*]: multiplicity set at pre-compile  # Signal | Configuration of a single pwm output signal.
        string rba_IoSigPwm_0CustSpecName [0..1]: multiplicity set at pre-compile, origin=RB:0.1.0:2011-11-08, set at pre-compile, max-length=60, min-length=1  # Customer-specific name | Customer-specific name of this signal. If present, this name is taken instead of the signal's "normal" short name for documentation and logging purposes.
        string rba_IoSigPwm_CalibAlterText [0..1]: multiplicity set at pre-compile, origin=RB:6.0.0:2014-11-27, post-build-variant-multiplicity=true, post-build-variant-value=true, set at pre-compile, max-length=32, min-length=1  # Calibration alternate text | Alternate text of the calibration variable for this signal used for HW signal routing. If present, this information is added as alternate HW signal routing information to the A2L-File. Please consult the customer documentation for more information.
        boolean rba_IoSigPwm_Calibratable [0..1]: multiplicity set at pre-compile, origin=RB:0.1.0:2011-05-09, post-build-variant-multiplicity=true, post-build-variant-value=true, set at pre-compile, default-value=false  # Calibration support | Activates the generation of a calibration variable for this signal to allow change of the HW signal routing. If this setting is activated, a RTE generator has to be used. Please consult the customer documentation for more information.
        enumeration rba_IoSigPwm_ChannelClass: origin=RB:0.1.0:2012-02-14, post-build-variant-value=true, set at pre-compile  # Channel Class | Defines whether the period can be changed in addition to the duty cycle. If only the duty cycle can be changed it also defines whether the period can be shifted.
          PWM_VARIABLE_PERIOD  # Variable Period
          PWM_FIXED_PERIOD  # Fixed Period
          PWM_FIXED_PERIOD_SHIFTED  # Fixed Period Shifted
        enumeration rba_IoSigPwm_ClockBase [0..1]: multiplicity set at pre-compile, origin=RB:0.1.0:2012-02-14, post-build-variant-multiplicity=true, post-build-variant-value=true, set at pre-compile, default-value=PWM_TIME  # Clock Base | Defines the clock source for Pwm signal: PWM_TIME: means the signal output clock source is a time base clock. PWM_ANGLE: means the signal output clock source is the angle clock from EPM (crankshaft)
          PWM_TIME  # Time Clock
          PWM_ANGLE  # Angle Clock
        string rba_IoSigPwm_ConnectedTo [1..*]: multiplicity set at pre-compile, origin=RB:0.1.0:2011-11-08, post-build-variant-multiplicity=true, post-build-variant-value=true, set at pre-compile, regular-expression=(^[A-Z][A-Z,a-z,0-9]*?)_.*  # Connected to | Specifies to which device and which pin on this device this signal is connected to. The general scheme of fully qualified pin specifications to be used here is <DeviceType>_<DeviceOrPortIdx>_<Pin>. <DeviceType> is the name of the device which transports this signal. This must be set to the short name of one of the devices in the "Device" section of IoSigPwm configuration. If the chosen device type is an external device (such as a power stage), then <DeviceOrPortIdx> specifies the zero-based index (counted per device type) of the device over which this signal is transferred. If the chosen device type is an MCU peripheral pin, however, then <DeviceOrPortIdx> specifies the MCU port over which this signal is transferred. <Pin> always specifies the index of the particular pin on the given device resp. port which transports this signal. The port and pin numbering schemes are device-specific. If more than one connection is configured, then the corresponding pins are driven in parallel (only possible for output signals on the same device, additionally HW-specific restrictions may apply).
        integer rba_IoSigPwm_InitDutyCycle: 0..100, origin=RB:0.1.0:2011-11-08, post-build-variant-value=true, set at pre-compile  # Init duty cycle | Duty cycle of this signal after initialization in %,the possible values are(0-100%)
        integer rba_IoSigPwm_InitPeriod: origin=RB:0.1.0:2011-11-08, post-build-variant-value=true, set at pre-compile  # Init Period in usec | Period of this signal after initialization (usec).
        enumeration rba_IoSigPwm_InitStrategy [0..1]: multiplicity set at pre-compile, origin=RB:0.1.0:2011-11-08, post-build-variant-multiplicity=true, post-build-variant-value=true, set at pre-compile, default-value=AnyReset  # Init strategy | Defines the (re-) initialization strategy of this signal. This setting is only relevant for output signals. Standard behaviour is that (re-) initialization takes place with any kind of reset. Not all hardware environments support all sorts of re-initialization strategies. Especially for starter power stage signals, set the value as Power-on reset.
          AnyReset  # Any reset
          PwrOnReset  # Power-on reset
        integer rba_IoSigPwm_MaxPeriod [0..1]: multiplicity set at pre-compile, origin=RB:0.1.0:2012-02-14, post-build-variant-multiplicity=true, post-build-variant-value=true, set at pre-compile  # Max Period in usec | Maximum period of this signal (usec) if class Variable Period is set.
        integer rba_IoSigPwm_MinPeriod [0..1]: multiplicity set at pre-compile, origin=RB:0.1.0:2012-02-14, post-build-variant-multiplicity=true, post-build-variant-value=true, set at pre-compile  # Min Period in usec | Minimum period of this signal (usec) if class Variable Period is set.
        function name rba_IoSigPwm_Notification [0..1]: multiplicity set at pre-compile, origin=RB:0.1.0:2011-11-08, post-build-variant-multiplicity=true, post-build-variant-value=true, set at pre-compile, regular-expression=[A-Za-z][A-Za-z_]*  # Notification | Defines the name of the optional callback function for this Signal
        boolean rba_IoSigPwm_OutDiagCurrent [0..1]: multiplicity set at pre-compile, origin=RB:6.0.0:2014-09-01, post-build-variant-multiplicity=true, post-build-variant-value=true, set at pre-compile  # Output diagnostic current | Enables/disables diagnostic current of power stages. The diagnostic current is necessary for power stages to distinguish between different error type like SCB, SCG and OL. The diagnostic current is typically enabled by default. For some use cases the diagnostic current must be disabled. If set to false the diagnostic current is disabled.
        enumeration rba_IoSigPwm_OutProtectStrategy [0..1]: multiplicity set at pre-compile, origin=RB:0.1.0:2011-11-08, post-build-variant-multiplicity=true, post-build-variant-value=true, set at pre-compile, default-value=Switchoff  # Output protection strategy | Defines the behaviour of the power stage in case of overload (only relevant for output signals). Possible reactions are automatic switch-off, current limitation, or no (automatic) reaction at all. In the latter case, application software is responsible for protecting the power stage from damage.
          SwitchOff  # Switch off
          CurrentLimit  # Current limitation
          NoProtect  # No protection
        enumeration rba_IoSigPwm_Polarity: origin=RB:0.1.0:2011-11-08, post-build-variant-value=true, set at pre-compile  # Polarity | Defines the starting state of each PWM Signal. Active State: means the signal output is in active state at the beginning of the cycle. Idle State: means the signal output is in idle state at the beginning of the cycle. It shall be set to Active State for normal use cases. If set to Idle State, all states are interpreted in negative logic. Use this only in exceptional cases, e.g. if you use an inverting actuator which is in active state when not being actuated, like an active closing valve.
          PWM_LOW  # Idle State
          PWM_HIGH  # Active State
        integer rba_IoSigPwm_SignalId [0..1]: multiplicity set at pre-compile, origin=RB:0.1.0:2011-11-08, set at pre-compile, with-auto=true  # SignalId | This signal ID is added to avoid internal warnings generated in IoSigPwm. This is not intended for user configuration.
        container rba_IoSigPwm_Diagnosis [0..1]: multiplicity set at pre-compile, post-build-variant-multiplicity=true  # Diagnostic support | Enables/disables diagnostic support for this signal (only relevant for output signals). If this container is present, the hardware is monitored for signal-specific failures like e.g. short circuit to ground and test pulses can be generated.
          string rba_IoSigPwm_DiagMonitoredCompOther [0..1]: multiplicity set at pre-compile, origin=RB:0.1.0:2011-05-09, set at pre-compile  # Other monitored component | It is mandatory to fill in the name of the monitored component if at least one of the parameters rba_IoSigPwm_DynCreate_RBA_IODIAGPS_OL, rba_IoSigPwm_DynCreate_RBA_IODIAGPS_OT, rba_IoSigPwm_DynCreate_RBA_IODIAGPS_SCB, rba_IoSigPwm_DynCreate_RBA_IODIAGPS_SCG is set to the value 'Standard' and the tag rba_IoSigPwm_DiagMonitoredComp is set to "other_component". This will be used to provide FXD information for the used DemEvents (with the DynCreate mode 'Standard'). Hint: This parameter value has a functional impact only, in case rba_IoDiagPs is accessed by AUTOSAR ASW using client/server interface of RTE. In case DEDia is still used, this parameter value is not effective.
          boolean rba_IoSigPwm_DiagTestPulse [0..1]: multiplicity set at pre-compile, origin=RB:0.1.0:2011-09-05, post-build-variant-multiplicity=true, post-build-variant-value=true, set at pre-compile, default-value=true  # Diagnostic test pulse support | Enables/disables support for diagnostic test pulses. If the parameter is set to false, it's not possible to activate test pulses during runtime for this signal. Hint: This parameter value has a functional impact only, in case rba_IoDiagPs is accessed by AUTOSAR ASW using client/server interface of RTE. In case DEDia is still used, this parameter value is not effective
          integer rba_IoSigPwm_DiagTestPulseDurActive: 1.., origin=RB:0.1.0:2011-11-08, post-build-variant-value=true, set at pre-compile  # Test pulse duration (active) [us] | Specifies the duration of test pulses which temporarily set the ECU output to "active" state. This value will also be used by power stages to determine if a specific error is testable without using test pulses. The unit of this setting is microseconds.
          integer rba_IoSigPwm_DiagTestPulseDurIdle: 1.., origin=RB:0.1.0:2011-11-08, post-build-variant-value=true, set at pre-compile  # Test pulse duration (idle) [us] | Specifies the duration of test pulses which temporarily set the ECU output to "idle" state. This value will also be used by power stages to determine if a specific error is testable without using test pulses. The unit of this setting is microseconds.
          enumeration rba_IoSigPwm_DynCreate_RBA_IODIAGPS_OL [0..1]: {Disabled, Standard}, multiplicity set at pre-compile, origin=RB:0.1.0:2014-10-08, post-build-variant-multiplicity=true, post-build-variant-value=true, set at pre-compile, default-value=Disabled  # Dynamically create Dem event for OL error | Selects the way how the Dem event for the open load error is created. If not set or set to "Disabled", no such Dem event is automatically created. If the dynamic creation of this Dem event is enabled, the reference to this Dem event is also automatically created and shall therefore not be set manually in parameter rba_IoSigPwm_DiagDemEventOL. Hint: This parameter value has a functional impact only, in case rba_IoDiagPs is accessed by AUTOSAR ASW using client/server interface of RTE. In case DEDia is still used, this parameter value is not effective.
          enumeration rba_IoSigPwm_DynCreate_RBA_IODIAGPS_OT [0..1]: {Disabled, Standard}, multiplicity set at pre-compile, origin=RB:0.1.0:2014-10-08, post-build-variant-multiplicity=true, post-build-variant-value=true, set at pre-compile, default-value=Disabled  # Dynamically create Dem event for OT error | Selects the way how the Dem event for the over temperature error is created. If not set or set to "Disabled", no such Dem event is automatically created. If the dynamic creation of this Dem event is enabled, the reference to this Dem event is also automatically created and shall therefore not be set manually in parameter rba_IoSigPwm_DiagDemEventOT. Hint: This parameter value has a functional impact only, in case rba_IoDiagPs is accessed by AUTOSAR ASW using client/server interface of RTE. In case DEDia is still used, this parameter value is not effective.
          enumeration rba_IoSigPwm_DynCreate_RBA_IODIAGPS_SCB [0..1]: {Disabled, Standard}, multiplicity set at pre-compile, origin=RB:0.1.0:2014-10-08, post-build-variant-multiplicity=true, post-build-variant-value=true, set at pre-compile, default-value=Disabled  # Dynamically create Dem event for SCB error | Selects the way how the Dem event for the short circuit to battery error is created. If not set or set to "Disabled", no such Dem event is automatically created. If the dynamic creation of this Dem event is enabled, the reference to this Dem event is also automatically created and shall therefore not be set manually in parameter rba_IoSigPwm_DiagDemEventSCB. Hint: This parameter value has a functional impact only, in case rba_IoDiagPs is accessed by AUTOSAR ASW using client/server interface of RTE. In case DEDia is still used, this parameter value is not effective.
          enumeration rba_IoSigPwm_DynCreate_RBA_IODIAGPS_SCG [0..1]: {Disabled, Standard}, multiplicity set at pre-compile, origin=RB:0.1.0:2014-10-08, post-build-variant-multiplicity=true, post-build-variant-value=true, set at pre-compile, default-value=Disabled  # Dynamically create Dem event for SCG error | Selects the way how the Dem event for the short circuit to ground error is created. If not set or set to "Disabled", no such Dem event is automatically created. If the dynamic creation of this Dem event is enabled, the reference to this Dem event is also automatically created and shall therefore not be set manually in parameter rba_IoSigPwm_DiagDemEventSCG. Hint: This parameter value has a functional impact only, in case rba_IoDiagPs is accessed by AUTOSAR ASW using client/server interface of RTE. In case DEDia is still used, this parameter value is not effective.
          symbolic name reference rba_IoSigPwm_DiagDemEventOL [0..1]: multiplicity set at pre-compile, origin=RB:0.1.0:2011-09-05, post-build-variant-multiplicity=true, post-build-variant-value=true, set at pre-compile, destination=DemEventParameter  # Dem event OL | Select the Dem event for reporting an open load error for this signal. Hint: This parameter value has a functional impact only, in case rba_IoDiagPs is accessed by AUTOSAR ASW using client/server interface of RTE. In case DEDia is still used, this parameter value is not effective.
          symbolic name reference rba_IoSigPwm_DiagDemEventOT [0..1]: multiplicity set at pre-compile, origin=RB:0.1.0:2011-09-05, post-build-variant-multiplicity=true, post-build-variant-value=true, set at pre-compile, destination=DemEventParameter  # Dem event OT | Select the Dem event for reporting an over temperature error for this signal. Hint: This parameter value has a functional impact only, in case rba_IoDiagPs is accessed by AUTOSAR ASW using client/server interface of RTE. In case DEDia is still used, this parameter value is not effective.
          symbolic name reference rba_IoSigPwm_DiagDemEventSCB [0..1]: multiplicity set at pre-compile, origin=RB:0.1.0:2011-09-05, post-build-variant-multiplicity=true, post-build-variant-value=true, set at pre-compile, destination=DemEventParameter  # Dem event SCB | Select the Dem event for reporting a short circuit to battery for this signal. Hint: This parameter value has a functional impact only, in case rba_IoDiagPs is accessed by AUTOSAR ASW using client/server interface of RTE. In case DEDia is still used, this parameter value is not effective.
          symbolic name reference rba_IoSigPwm_DiagDemEventSCG [0..1]: multiplicity set at pre-compile, origin=RB:0.1.0:2011-09-05, post-build-variant-multiplicity=true, post-build-variant-value=true, set at pre-compile, destination=DemEventParameter  # Dem event SCG | Select the Dem event for reporting a short circuit to ground for this signal. Hint: This parameter value has a functional impact only, in case rba_IoDiagPs is accessed by AUTOSAR ASW using client/server interface of RTE. In case DEDia is still used, this parameter value is not effective.
          reference rba_IoSigPwm_DiagMonitoredComp [0..1]: multiplicity set at pre-compile, origin=RB:0.1.0:2011-05-09, set at pre-compile, destination=DemRbGDocMonitoredComponent  # Monitored component | Select the monitored component or monitored system from the referenced list. In case any of the tags rba_IoSigPwm_DynCreate_RBA_IODIAGPS_OL, rba_IoSigPwm_DynCreate_RBA_IODIAGPS_OT, rba_IoSigPwm_DynCreate_RBA_IODIAGPS_SCB, rba_IoSigPwm_DynCreate_RBA_IODIAGPS_SCG is set to the value 'Standard' it is mandatory to select an item from the referenced list of monitored components. If none of the options fit, select 'other_component' and fill the parameter rba_IoSigPwm_DiagMonitoredCompOther. This will be used to provide FXD information for the used DemEvents (with the DynCreate mode 'Standard'). Hint: This parameter value has a functional impact only, in case rba_IoDiagPs is accessed by AUTOSAR ASW using client/server interface of RTE. In case DEDia is still used, this parameter value is not effective.
    container rba_IoSigPwm_Device [1..*]: multiplicity set at pre-compile  # Device | Information about each device which is available for carrying digital input/output signals and can be addressed by this module.
      string rba_IoSigPwm_DeviceCompName: origin=RB:0.1.0:2011-11-08, set at pre-compile, with-auto=true, max-length=32, min-length=1, regular-expression=[A-Za-z_][A-Za-z0-9_]*  # Component name | Name of the SW component implementing the driver for this device. This may differ from the actual device name due to naming conventions or in case that one driver SW component supports more than one device.
      string rba_IoSigPwm_DeviceDescName: origin=RB:0.1.0:2011-11-08, set at pre-compile, with-auto=true, regular-expression=[A-Za-z_][A-Za-z0-9_]*  # Descriptor name | Name of the device interface descriptor which contains all necessary information on device-specific implementations of PWM functionality.
      string rba_IoSigPwm_DeviceHeader: origin=RB:0.1.0:2011-11-08, set at pre-compile, with-auto=true, max-length=128, min-length=1, regular-expression=[A-Za-z_][A-Za-z0-9_]*\.[A-Za-z0-9_]+  # Header file | Name of the header file which declares the device interface descriptor.
    container rba_IoSigPwm_General  # General settings | Configuration of general aspects of the IoSigPwm module.
      boolean rba_IoSigPwm_DevErrorDetect: origin=RB:0.1.0:2011-11-08, set at pre-compile  # Development error detection | Enables/disables the detection and notification of development errors. If this parameter is enabled, then extended error checking is performed during runtime; any errors detected by these checks are reported to the Det module. This feature should be switched off in series software.
      enumeration rba_IoSigPwm_GenArxmlVersion [0..1]: multiplicity set at pre-compile, origin=RB:0.1.0:2011-05-09, set at pre-compile, default-value=GEN_ARXML_VERSION_402  # Version of generated ARXML files for RTE interface | Version of the generated ARXML files used for the RTE interface.It is obsolete and will be removed in the future release since the version of ARXML files now depends on AUTOSAR version configured in EcuC module.
        GEN_ARXML_VERSION_402  # 4.0R2
      enumeration rba_IoSigPwm_RequestHandling: {Ignore, Strict}, origin=RB:0.1.0:2011-11-08, set at pre-compile  # Request handling | Determines the way how signal requests are processed. If set to "Ignore", all signal requests are completely and silently ignored.
      boolean rba_IoSigPwm_VersionInfoApi: origin=RB:0.1.0:2011-11-08, set at pre-compile  # Version information API | Enables/disables the GetVersionInfo() API. This functionality can be used e.g. for providing version information to test equipment.
    container rba_IoSigPwm_SignalRequest [0..*]: multiplicity set at pre-compile  # Signal request | Request of a single pwm output signal.
      boolean rba_IoSigPwm_Calibratable [0..1]: multiplicity set at pre-compile, origin=RB:2.25.0:2017-02-22, set at pre-compile, default-value=false  # Calibration Support | Activates the generation of a calibration variable for this signal to allow change of the HW signal routing. If this setting is activated, an RTE generator has to be used. Please consult the customer documentation for more information.
      enumeration rba_IoSigPwm_ChannelClass [0..1]: multiplicity set at pre-compile, origin=RB:0.1.0:2012-02-14, set at pre-compile  # Channel Class | Defines whether the period can be changed in addition to the duty cycle. If only the duty cycle can be changed it also defines whether the period can be shifted.
        PWM_VARIABLE_PERIOD  # Variable Period
        PWM_FIXED_PERIOD  # Fixed Period
        PWM_FIXED_PERIOD_SHIFTED  # Fixed Period Shifted
      enumeration rba_IoSigPwm_ClockBase [0..1]: multiplicity set at pre-compile, origin=RB:0.1.0:2012-02-14, set at pre-compile  # Clock Base | Defines the clock source for Pwm signal: PWM_TIME: means the signal output clock source is a time base clock. PWM_ANGLE: means the signal output clock source is the angle clock from EPM(crankshaft)
        PWM_TIME  # Time Clock
        PWM_ANGLE  # Angle Clock
      boolean rba_IoSigPwm_Diag [0..1]: multiplicity set at pre-compile, origin=RB:0.1.0:2011-11-08, set at pre-compile  # Diagnostic support | Enables/disables diagnostic support for this signal (only relevant for output signals). If enabled, the hardware is monitored for signal-specific failures like e.g. short circuit to ground and test pulses can be generated.
      integer rba_IoSigPwm_InitDutyCycle [0..1]: 0..100, multiplicity set at pre-compile, origin=RB:0.1.0:2012-02-14, set at pre-compile  # Init duty cycle | Duty cycle of this signal after initialization in %, the possible values are (0-100%)
      integer rba_IoSigPwm_InitPeriod [0..1]: multiplicity set at pre-compile, origin=RB:0.1.0:2011-11-08, set at pre-compile  # Init Period in usec | Period of this signal after initialization (us). This setting is only relevant for output signals.
      enumeration rba_IoSigPwm_InitStrategy [0..1]: multiplicity set at pre-compile, origin=RB:0.1.0:2011-11-08, set at pre-compile  # Init strategy | Defines the (re-) initialization strategy of this signal. This setting is only relevant for output signals. Standard behaviour is that (re-) initialization takes place with any kind of reset. Not all hardware environments support all sorts of re-initialization strategies. Especially for starter power stage signals, set the value as Power-on reset.
        AnyReset  # Any reset
        PwrOnReset  # Power-on reset
      integer rba_IoSigPwm_MaxPeriod [0..1]: multiplicity set at pre-compile, origin=RB:0.1.0:2012-02-14, set at pre-compile  # Max Period in usec | Maximum period of this signal (usec) if class Variable Period is set.
      integer rba_IoSigPwm_MinPeriod [0..1]: multiplicity set at pre-compile, origin=RB:0.1.0:2012-02-14, set at pre-compile  # Min Period in usec | Minimum period of this signal (usec) if class Variable Period is set.
      function name rba_IoSigPwm_Notification [0..1]: multiplicity set at pre-compile, origin=RB:0.1.0:2011-08-11, set at pre-compile, regular-expression=[A-Za-z][A-Za-z_]*  # Notification | Defines the name of the optional callback function for this signal..
      enumeration rba_IoSigPwm_OutProtectStrategy [0..1]: multiplicity set at pre-compile, origin=RB:0.1.0:2011-08-11, set at pre-compile  # Output protection strategy | Defines the behaviour of the power stage in case of overload (only relevant for output signals). Possible reactions are automatic switch-off, current limitation, or no (automatic) reaction at all. In the latter case, application software is responsible for protecting the power stage from damage.
        SwitchOff  # Switch off
        CurrentLimit  # Current limitation
        NoProtect  # No protection
