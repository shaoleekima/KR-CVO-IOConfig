AUTOSAR XML (schema 4-0-2)
package /RB/UBK/Project/EcucModuleConfigurationValuess
  module config Pwm
    PwmChannelConfigSet
    PwmOptionalApi:
      PwmDeInitApi = true
      PwmGetOutputStateApi = true
      PwmRbMedc17LegacyApi = true
      PwmSetDutyCycleApi = true
      PwmSetOutputToIdleApi = true
      PwmSetPeriodAndDutyApi = true
      PwmVersionInfoApi = true
  module config rba_Gtm
    rba_Gtm_Config
  module config rba_IoSigPwm
    rba_IoSigPwm_General: rba_IoSigPwm_DevErrorDetect=true, rba_IoSigPwm_RequestHandling=Strict, rba_IoSigPwm_VersionInfoApi=false
    rba_IoSigPwm_ConfigSet
      4 x rba_IoSigPwm_Signal, all with rba_IoSigPwm_Calibratable=true, rba_IoSigPwm_ChannelClass=PWM_VARIABLE_PERIOD, rba_IoSigPwm_ClockBase=PWM_TIME, rba_IoSigPwm_InitDutyCycle=0, rba_IoSigPwm_InitPeriod=10000, rba_IoSigPwm_InitStrategy=AnyReset, rba_IoSigPwm_OutProtectStrategy=SwitchOff, rba_IoSigPwm_Polarity=PWM_HIGH:
        CABVlv_O_P: rba_IoSigPwm_0CustSpecName=Charged_Air_Coolant_Bypass_Valve, rba_IoSigPwm_CalibAlterText=DUMMY_PWM_01, rba_IoSigPwm_ConnectedTo=NULL_02_01, rba_IoSigPwm_MaxPeriod=10000, rba_IoSigPwm_MinPeriod=500
        O_T_RL06: rba_IoSigPwm_0CustSpecName=O_T_RL06, rba_IoSigPwm_CalibAlterText=O_T_RL06, rba_IoSigPwm_MaxPeriod=1000000, rba_IoSigPwm_MinPeriod=5000, rba_IoSigPwm_OutDiagCurrent=true, rba_IoSigPwm_ConnectedTo=TLE7244_01_02  # TLE7244 O_T_RL06
        O_T_RL07: rba_IoSigPwm_0CustSpecName=O_T_RL07, rba_IoSigPwm_CalibAlterText=O_T_RL07, rba_IoSigPwm_MaxPeriod=1000000, rba_IoSigPwm_MinPeriod=5000, rba_IoSigPwm_OutDiagCurrent=true, rba_IoSigPwm_ConnectedTo=TLE7244_01_03
        O_T_RL08: rba_IoSigPwm_0CustSpecName=O_T_RL08, rba_IoSigPwm_CalibAlterText=O_T_RL08, rba_IoSigPwm_MaxPeriod=1000000, rba_IoSigPwm_MinPeriod=5000, rba_IoSigPwm_OutDiagCurrent=true, rba_IoSigPwm_ConnectedTo=TLE7244_01_04
    3 x rba_IoSigPwm_SignalRequest, all with rba_IoSigPwm_Calibratable=true:
      O_T_RL{06..08}
