AUTOSAR XML (schema 4-2-2)
package /RB/RBA/rba_IoSigDio/EcucModuleDefs
  module definition rba_IoSigDio [0..1]: category=VENDOR_SPECIFIC_MODULE_DEFINITION, post-build-variant-support=true, variants pre-compile  # I/O Signals: Digital | Configuration of all digital input/output signals of an ECU.
    container rba_IoSigDio_ConfigSet  # Configuration data set | Defines one data set of post-build configuration. Which of these data sets is actually active is controlled by EcuM. Data sets can only be switched at initialization time.
      container rba_IoSigDio_Signal [0..*]: multiplicity set at pre-compile  # Signal | Configuration of a single digital input/output signal.
        string rba_IoSigDio_0CustSpecName [0..1]: multiplicity set at pre-compile, origin=RB:0.1.0:2011-05-09, set at pre-compile, max-length=32, min-length=1  # Customer-specific name | Customer-specific name of this signal. If present, this name is taken instead of the signal's "normal" short name for documentation and logging purposes.
        string rba_IoSigDio_1ConnectedTo [1..*]: multiplicity set at pre-compile, origin=RB:0.1.0:2011-05-09, post-build-variant-multiplicity=true, post-build-variant-value=true, set at pre-compile, regular-expression=(^[A-Z][A-Z,a-z,0-9]*?)_.*  # Connected to | Specifies to which device and which pin on this device this signal is connected to. The general scheme of fully qualified pin specifications to be used here is <DevType>_<DevOrPortIdx>_<Pin>. <DevType> is the name of the device which transports this signal. This must be set to the short name of one of the devices in the "Device" section of IoSigDio configuration. If the chosen device type is an external device (such as a power stage), then <DevOrPortIdx> specifies the one-based index (counted per device type) of the device over which this signal is transferred. If the chosen device type is an MCU peripheral such as Dio, however, then <DevOrPortIdx> specifies the MCU port over which this signal is transferred. <Pin> always specifies the index of the particular pin on the given device resp. port which transports this signal. The port and pin numbering schemes are device-specific. If more than one connection is configured, then the corresponding pins are driven in parallel (only possible for output signals on the same device, additionally HW-specific restrictions may apply).
        enumeration rba_IoSigDio_1Direction: {Input, Output}, origin=RB:0.1.0:2011-05-09, post-build-variant-value=true, set at pre-compile  # Direction | Direction of this signal.
        boolean rba_IoSigDio_1DirectionChangeable [0..1]: multiplicity set at pre-compile, origin=RB:0.1.0:2011-07-26, post-build-variant-multiplicity=true, post-build-variant-value=true, set at pre-compile, default-value=false  # Direction changeable | Enables/disables whether the direction of this signal is changeable at run-time.
        boolean rba_IoSigDio_1Invert [0..1]: multiplicity set at pre-compile, origin=RB:0.1.0:2011-05-09, post-build-variant-multiplicity=true, post-build-variant-value=true, set at pre-compile, default-value=false  # Inversion | If set to true, all levels are interpreted in negative logic. Use this only in exceptional cases, e.g. if an active actuator (with a high physical level corresponding to the "active" state) is connected to a low-side power stage (which outputs a low physical level in the "active" state) or if the state of a switch connected to ground shall be read from a digital input.
        string rba_IoSigDio_CalibAlterText [0..1]: multiplicity set at pre-compile, origin=RB:0.1.0:2014-12-08, post-build-variant-multiplicity=true, post-build-variant-value=true, set at pre-compile, max-length=32, min-length=1  # Calibration alternate text | Alternate text of the calibration variable for this signal used for HW signal routing. If present, this information is added as alternate HW signal routing information to the A2L-File. Please consult the customer documentation for more information.
        boolean rba_IoSigDio_Calibratable [0..1]: multiplicity set at pre-compile, origin=RB:0.1.0:2011-05-09, post-build-variant-multiplicity=true, post-build-variant-value=true, set at pre-compile, default-value=false  # Calibration routing support | Activates the generation of a calibration variable for this signal to allow change of the HW signal routing. If this setting is activated, a RTE generator has to be used. Please consult the customer documentation for more information.
        boolean rba_IoSigDio_CalibratableInvert [0..1]: multiplicity set at pre-compile, origin=RB:0.1.0:2016-02-22, post-build-variant-multiplicity=true, post-build-variant-value=true, set at pre-compile, default-value=false  # Calibration inversion support | Activates the generation of a calibration variable for this signal to allow the change of the signal state inversion. If this setting is activated, a RTE generator has to be used. Please consult the customer documentation for more information.
        enumeration rba_IoSigDio_InitState [0..1]: {Idle, Active}, multiplicity set at pre-compile, origin=RB:0.1.0:2011-05-09, post-build-variant-multiplicity=true, post-build-variant-value=true, set at pre-compile, default-value=Idle  # Init state | State of this signal after initialization. This setting is only relevant for output signals. If this parameter is not specified, it defaults to inactive state.
        enumeration rba_IoSigDio_InitStrategy [0..1]: multiplicity set at pre-compile, origin=RB:0.1.0:2011-05-09, post-build-variant-multiplicity=true, post-build-variant-value=true, set at pre-compile, default-value=AnyReset  # Init strategy | Defines the (re-) initialization strategy of this signal. This setting is only relevant for output signals. Standard behaviour is that (re-) initialization takes place with any kind of reset. Not all hardware environments support all sorts of re-initialization strategies. Especially for starter power stage signals, adjust the value Power-on reset.
          AnyReset  # Any reset
          PwrOnReset  # Power-on reset
        boolean rba_IoSigDio_OutDiagCurrent [0..1]: multiplicity set at pre-compile, origin=RB:0.1.0:2014-12-05, post-build-variant-multiplicity=true, post-build-variant-value=true, set at pre-compile  # Output diagnostic current | Enables/disables diagnostic current of power stages. The diagnostic current is necessary for power stages to distinguish between different error type like SCB, SCG and OL. The diagnostic current is typically enabled by default. For some use cases the diagnostic current must be disabled. If set to false the diagnostic current is disabled.
        enumeration rba_IoSigDio_OutProtectStrategy [0..1]: multiplicity set at pre-compile, origin=RB:0.1.0:2011-05-09, post-build-variant-multiplicity=true, post-build-variant-value=true, set at pre-compile  # Output protection strategy | Defines the behaviour of the power stage in case of overload (only relevant for output signals). Possible reactions are automatic switch-off, current limitation, or no (automatic) reaction at all. In the latter case, application software has is responsible for protecting the power stage from damage.
          SwitchOff  # Switch-off
          CurrentLimit  # Current limitation
          NoProtect  # No protection
        container rba_IoSigDio_Diagnosis [0..1]: multiplicity set at pre-compile, post-build-variant-multiplicity=true  # Diagnostic support | Enables/disables diagnostic support for this signal (only relevant for output signals). If this container is present, the hardware is monitored for signal-specific failures like e.g. short circuit to ground and test pulses can be generated.
          string rba_IoSigDio_DiagMonitoredCompOther [0..1]: multiplicity set at pre-compile, origin=RB:0.1.0:2011-05-09, set at pre-compile  # Other monitored component | It is mandatory to fill in the name of the monitored component if at least one of the parameters rba_IoSigDio_DynCreate_RBA_IODIAGPS_OL, rba_IoSigDio_DynCreate_RBA_IODIAGPS_OT, rba_IoSigDio_DynCreate_RBA_IODIAGPS_SCB, rba_IoSigDio_DynCreate_RBA_IODIAGPS_SCG is set to the value 'Standard' and the tag rba_IoSigDio_DiagMonitoredComp is set to "other_component". This will be used to provide FXD information for the used DemEvents (with the DynCreate mode 'Standard'). Hint: This parameter value has a functional impact only, in case rba_IoDiagPs is accessed by AUTOSAR ASW using client/server interface of RTE. In case DEDia is still used, this parameter value is not effective.
          boolean rba_IoSigDio_DiagTestPulse [0..1]: multiplicity set at pre-compile, origin=RB:0.1.0:2011-05-09, post-build-variant-multiplicity=true, post-build-variant-value=true, set at pre-compile, default-value=true  # Diagnostic test pulse support | Enables/disables support for diagnostic test pulses. If the parameter is set to false, it's not possible to activate test pulses during runtime for this signal. Hint: This parameter value has a functional impact only, in case rba_IoDiagPs is accessed by AUTOSAR ASW using client/server interface of RTE. In case DEDia is still used, this parameter value is not effective.
          integer rba_IoSigDio_DiagTestPulseDurActive: 1.., origin=RB:0.1.0:2011-05-09, post-build-variant-value=true, set at pre-compile  # Test pulse duration (active) [us] | Specifies the duration of test pulses which temporarily set the ECU output to "active" state. This value will also be used by power stages to determine if a specific error is testable without using test pulses. The unit of this setting is microseconds.
          integer rba_IoSigDio_DiagTestPulseDurIdle: 1.., origin=RB:0.1.0:2011-05-09, post-build-variant-value=true, set at pre-compile  # Test pulse duration (idle) [us] | Specifies the duration of test pulses which temporarily set the ECU output to "idle" state. This value will also be used by power stages to determine if a specific error is testable without using test pulses. The unit of this setting is microseconds.
          enumeration rba_IoSigDio_DynCreate_RBA_IODIAGPS_OL [0..1]: {Disabled, Standard}, multiplicity set at pre-compile, origin=RB:0.1.0:2014-10-08, post-build-variant-multiplicity=true, post-build-variant-value=true, set at pre-compile, default-value=Disabled  # Dynamically create Dem event for OL error | Selects the way how the Dem event for the open load error is created. If not set or set to "Disabled", no such Dem event is automatically created. If the dynamic creation of this Dem event is enabled, the reference to this Dem event is also automatically created (at rba_IoDiagPs) and shall therefore not be set manually in parameter rba_IoSigDio_DiagDemEventOL. Hint: This parameter value has a functional impact only, in case rba_IoDiagPs is accessed by AUTOSAR ASW using client/server interface of RTE. In case DEDia is still used, this parameter value is not effective.
          enumeration rba_IoSigDio_DynCreate_RBA_IODIAGPS_OT [0..1]: {Disabled, Standard}, multiplicity set at pre-compile, origin=RB:0.1.0:2014-10-08, post-build-variant-multiplicity=true, post-build-variant-value=true, set at pre-compile, default-value=Disabled  # Dynamically create Dem event for OT error | Selects the way how the Dem event for the open load error is created. If not set or set to "Disabled", no such Dem event is automatically created. If the dynamic creation of this Dem event is enabled, the reference to this Dem event is also automatically created (at rba_IoDiagPs) and shall therefore not be set manually in parameter rba_IoSigDio_DiagDemEventOT. Hint: This parameter value has a functional impact only, in case rba_IoDiagPs is accessed by AUTOSAR ASW using client/server interface of RTE. In case DEDia is still used, this parameter value is not effective.
          enumeration rba_IoSigDio_DynCreate_RBA_IODIAGPS_SCB [0..1]: {Disabled, Standard}, multiplicity set at pre-compile, origin=RB:0.1.0:2014-10-08, post-build-variant-multiplicity=true, post-build-variant-value=true, set at pre-compile, default-value=Disabled  # Dynamically create Dem event for SCB error | Selects the way how the Dem event for the open load error is created. If not set or set to "Disabled", no such Dem event is automatically created. If the dynamic creation of this Dem event is enabled, the reference to this Dem event is also automatically created (at rba_IoDiagPs) and shall therefore not be set manually in parameter rba_IoSigDio_DiagDemEventSCB. Hint: This parameter value has a functional impact only, in case rba_IoDiagPs is accessed by AUTOSAR ASW using client/server interface of RTE. In case DEDia is still used, this parameter value is not effective.
          enumeration rba_IoSigDio_DynCreate_RBA_IODIAGPS_SCG [0..1]: {Disabled, Standard}, multiplicity set at pre-compile, origin=RB:0.1.0:2014-10-08, post-build-variant-multiplicity=true, post-build-variant-value=true, set at pre-compile, default-value=Disabled  # Dynamically create Dem event for SCG error | Selects the way how the Dem event for the open load error is created. If not set or set to "Disabled", no such Dem event is automatically created. If the dynamic creation of this Dem event is enabled, the reference to this Dem event is also automatically created (at rba_IoDiagPs) and shall therefore not be set manually in parameter rba_IoSigDio_DiagDemEventSCG. Hint: This parameter value has a functional impact only, in case rba_IoDiagPs is accessed by AUTOSAR ASW using client/server interface of RTE. In case DEDia is still used, this parameter value is not effective.
          symbolic name reference rba_IoSigDio_DiagDemEventOL [0..1]: multiplicity set at pre-compile, origin=RB:0.1.0:2011-05-09, post-build-variant-multiplicity=true, post-build-variant-value=true, set at pre-compile, destination=DemEventParameter  # Dem event OL | Select the DEM event for reporting an open load error for this signal. Hint: This parameter value has a functional impact only, in case rba_IoDiagPs is accessed by AUTOSAR ASW using client/server interface of RTE. In case DEDia is still used, this parameter value is not effective.
          symbolic name reference rba_IoSigDio_DiagDemEventOT [0..1]: multiplicity set at pre-compile, origin=RB:0.1.0:2011-05-09, post-build-variant-multiplicity=true, post-build-variant-value=true, set at pre-compile, destination=DemEventParameter  # Dem event OT | Select the DEM event for reporting an over temperature error for this signal. Hint: This parameter value has a functional impact only, in case rba_IoDiagPs is accessed by AUTOSAR ASW using client/server interface of RTE. In case DEDia is still used, this parameter value is not effective.
          symbolic name reference rba_IoSigDio_DiagDemEventSCB [0..1]: multiplicity set at pre-compile, origin=RB:0.1.0:2011-05-09, post-build-variant-multiplicity=true, post-build-variant-value=true, set at pre-compile, destination=DemEventParameter  # Dem event SCB | Select the DEM event for reporting a short circuit to battery error for this signal. Hint: This parameter value has a functional impact only, in case rba_IoDiagPs is accessed by AUTOSAR ASW using client/server interface of RTE. In case DEDia is still used, this parameter value is not effective.
          symbolic name reference rba_IoSigDio_DiagDemEventSCG [0..1]: multiplicity set at pre-compile, origin=RB:0.1.0:2011-05-09, post-build-variant-multiplicity=true, post-build-variant-value=true, set at pre-compile, destination=DemEventParameter  # Dem event SCG | Select the DEM event for reporting a short circuit to ground error for this signal. Hint: This parameter value has a functional impact only, in case rba_IoDiagPs is accessed by AUTOSAR ASW using client/server interface of RTE. In case DEDia is still used, this parameter value is not effective.
          reference rba_IoSigDio_DiagMonitoredComp [0..1]: multiplicity set at pre-compile, origin=RB:0.1.0:2011-05-09, set at pre-compile, destination=DemRbGDocMonitoredComponent  # Monitored component | Select the monitored component or monitored system from the referenced list. In case at least one of the parameters rba_IoSigDio_DynCreate_RBA_IODIAGPS_OL, rba_IoSigDio_DynCreate_RBA_IODIAGPS_OT, rba_IoSigDio_DynCreate_RBA_IODIAGPS_SCB, rba_IoSigDio_DynCreate_RBA_IODIAGPS_SCG is set to the value 'Standard' it is mandatory to select an item from the referenced list of monitored components. If none of the options fit, select 'other_component' and fill the parameter rba_IoSigDio_DiagMonitoredCompOther. This will be used to provide FXD information for the used DemEvents (with the DynCreate mode 'Standard'). Hint: This parameter value has a functional impact only, in case rba_IoDiagPs is accessed by AUTOSAR ASW using client/server interface of RTE. In case DEDia is still used, this parameter value is not effective.
    container rba_IoSigDio_Device [1..*]: multiplicity set at pre-compile  # Device | Information about each device which is available for carrying digital input/output signals and can be addressed by this module.
      string rba_IoSigDio_DeviceCompName: origin=RB:0.1.0:2011-05-09, set at pre-compile, with-auto=true, max-length=32, min-length=1, regular-expression=[A-Za-z][A-Za-z0-9_]*  # Component name | Name of the SW component implementing the driver for this device. This may differ from the actual device name due to naming conventions or in case that one driver SW component supports more than one device.
      linker symbol rba_IoSigDio_DeviceDescName: origin=RB:0.1.0:2011-05-09, set at pre-compile, with-auto=true  # Descriptor name | Name of the device interface descriptor which contains all necessary information on device-specific implementations of digital I/O functionality.
      string rba_IoSigDio_DeviceHeader: origin=RB:0.1.0:2011-05-09, set at pre-compile, with-auto=true, max-length=128, min-length=1, regular-expression=[A-Za-z][A-Za-z0-9_]*\.h  # Header file | Name of the header file which declares the device interface descriptor.
    container rba_IoSigDio_General  # General settings | Configuration of general aspects of the IoSigDio module.
      boolean rba_IoSigDio_DevErrorDetect: origin=RB:0.1.0:2011-05-09, set at pre-compile  # Development error detection | Enables/disables the reporting of development errors. If this parameter is enabled, any detected errors are reported to the Det module. This feature should be switched off in series software.
      enumeration rba_IoSigDio_GenArxmlVersion [0..1]: multiplicity set at pre-compile, origin=RB:0.1.0:2011-05-09, set at pre-compile, default-value=GEN_ARXML_VERSION_402  # Version of generated ARXML files for RTE interface | Version of the generated ARXML files used for the RTE interface. It is obsolete and will be removed in the future release since the version of ARXML files now depends on AUTOSAR version configured in EcuC module.
        GEN_ARXML_VERSION_402  # 4.0R2
      enumeration rba_IoSigDio_RequestHandling: {Ignore, Strict}, origin=RB:0.1.0:2011-05-09, set at pre-compile  # Request handling | Determines the way how signal requests are processed. If set to "Ignore", all signal requests are completely and silently ignored. If set to "Strict", then (1) each requested signal must be configured in all data sets (2) all signal properties specified in the request must be configured identically to this specification in all data sets.
      integer rba_IoSigDio_ThresholdAdcActive [0..1]: -32768..32767, multiplicity set at pre-compile, origin=RB:0.1.0:2011-05-09, set at pre-compile, default-value=24576  # Threshold ADC input active | Specifies the upper hysteresis threshold for all digital signals read in and sampled by an analog-digital-converter. In case the sampled value is equal or greater this threshold, the signal is set to active state. The state of the signal remains unchanged in case the value is in between the active and idle threshold. The resolution of this setting is 5V / 32768bit.
      integer rba_IoSigDio_ThresholdAdcIdle [0..1]: -32768..32767, multiplicity set at pre-compile, origin=RB:0.1.0:2011-05-09, set at pre-compile, default-value=8192  # Threshold ADC input idle | Specifies the lower hysteresis threshold for all digital signals read in and sampled by an analog-digital-converter. In case the sampled value is equal or below this threshold, the signal is set to idle state. The state of the signal remains unchanged in case the value is in between the active and idle threshold. The resolution of this setting is 5V / 32768bit.
      boolean rba_IoSigDio_ValidationInversion [0..1]: multiplicity set at pre-compile, origin=RB:0.1.0:2011-05-09, set at pre-compile, default-value=true  # Validation of inversion | Enables/disables inversion validation. With the introduction of the dynamic state inversion feature, the signal state inversion (static and dynamic) is not anymore exceuted AFTER the signal routing. It is now executed BEFORE the signal routing. In case the signal routing feature is activated and for those signals different state inversions are configured, the inversion of those signals might be different. During code generation this kind of configuration is validated and the build will break with an error message to re-work the state inversion configuration. After re-working the state inversion, the validation can be disabled by this parameter (false).
      boolean rba_IoSigDio_VersionInfoApi: origin=RB:0.1.0:2011-05-09, set at pre-compile  # Version information API | Enables/disables the GetVersionInfo() API. This functionality can be used e.g. for providing version information to test equipment.
    container rba_IoSigDio_SignalRequest [0..*]: multiplicity set at pre-compile  # Signal request | Request of a single digital input/output signal. Optional parameters of a signal request which are left unspecified are interpreted as "don't care".
      enumeration rba_IoSigDio_1Direction: {Input, Output}, origin=RB:0.1.0:2011-05-09, set at pre-compile  # Direction | Direction of this signal.
      boolean rba_IoSigDio_1DirectionChangeable [0..1]: multiplicity set at pre-compile, origin=RB:0.1.0:2011-07-26, set at pre-compile  # Direction changeable | Enables/disables whether the direction of this signal is changeable at run-time.
      boolean rba_IoSigDio_Calibratable [0..1]: multiplicity set at pre-compile, origin=RB:2.22.0:2017-04-28, set at pre-compile  # Calibration routing support | Activates the generation of a calibration variable for this signal to allow change of the HW signal routing. If this setting is activated, a RTE generator has to be used. Please consult the customer documentation for more information.
      boolean rba_IoSigDio_Diag [0..1]: multiplicity set at pre-compile, origin=RB:0.1.0:2011-05-09, set at pre-compile  # Diagnostic support | Enables/disables diagnostic support for this signal (only relevant for output signals). If enabled, the hardware is monitored for signal-specific failures like e.g. short circuit to ground and test pulses can be generated.
      enumeration rba_IoSigDio_InitState [0..1]: {Idle, Active}, multiplicity set at pre-compile, origin=RB:0.1.0:2011-05-09, set at pre-compile  # Init state | State of this signal after initialization. This setting is only relevant for output signals.
      enumeration rba_IoSigDio_InitStrategy [0..1]: multiplicity set at pre-compile, origin=RB:0.1.0:2011-05-09, set at pre-compile  # Init strategy | Defines the (re-) initialization strategy of this signal. This setting is only relevant for output signals. Standard behaviour is that (re-) initialization takes place with any kind of reset. Not all hardware environments support all sorts of re-initialization strategies.
        AnyReset  # Any reset
        PwrOnReset  # Power-on reset
      enumeration rba_IoSigDio_OutProtectStrategy [0..1]: multiplicity set at pre-compile, origin=RB:0.1.0:2011-05-09, set at pre-compile  # Output protection strategy | Defines the behaviour of the power stage in case of overload (only relevant for output signals). Possible reactions are automatic switch-off, current limitation, or no (automatic) reaction at all. In the latter case, application software has is responsible for protecting the power stage from damage.
        SwitchOff  # Switch-off
        CurrentLimit  # Current limitation
        NoProtect  # No protection
