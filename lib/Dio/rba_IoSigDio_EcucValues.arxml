AUTOSAR XML (schema 4-0-2)
package /RB/UBK/Project/EcucModuleConfigurationValuess
  module config Port
    PortConfigSet
      3 x PortContainer:
        Port_20
          CTO_S7000_LSS_EN (PortPin):
            PortPinDirection = PORT_PIN_DIRECTION_OUT
            PortPinInitialMode = PORT_PIN_MODE_OUTPUT_DIO
            PortPinLevelValue = PORT_PIN_LEVEL_LOW
            PortPinMode = PORT_PIN_MODE_OUTPUT_DIO
            PortPinModeChangeable = false
            PortPinRbCharacteristicOutput = PORT_PIN_CHARACTERISTIC_OUTPUT_PUSHPULL
            PortPinRbHwConnector = PORT_20_09
            PortPinStrength = PORT_PIN_STRENGTH_MEDIUM
          CTO_S7000_LSS_ST (PortPin):
            PortPinDirection = PORT_PIN_DIRECTION_IN
            PortPinInitialMode = PORT_PIN_MODE_INPUT_DIO
            PortPinLevelValue = PORT_PIN_LEVEL_LOW
            PortPinMode = PORT_PIN_MODE_INPUT_DIO
            PortPinModeChangeable = false
            PortPinRbCharacteristicInput = PORT_PIN_CHARACTERISTIC_INPUT_NOPULL
            PortPinRbFeature = PORT_PIN_FEATURE_INPUT_TTL
            PortPinRbHwConnector = PORT_20_10
        Port_00
          CTO_ST_INH1 (PortPin):
            PortPinDirection = PORT_PIN_DIRECTION_IN
            PortPinInitialMode = PORT_PIN_MODE_INPUT_DIO
            PortPinLevelValue = PORT_PIN_LEVEL_LOW
            PortPinMode = PORT_PIN_MODE_INPUT_DIO
            PortPinModeChangeable = false
            PortPinRbCharacteristicInput = PORT_PIN_CHARACTERISTIC_INPUT_NOPULL
            PortPinRbFeature = PORT_PIN_FEATURE_INPUT_AUTOMOTIVE
            PortPinRbHwConnector = PORT_00_10
          CTO_ST_INH2 (PortPin):
            PortPinDirection = PORT_PIN_DIRECTION_IN
            PortPinInitialMode = PORT_PIN_MODE_INPUT_DIO
            PortPinLevelValue = PORT_PIN_LEVEL_LOW
            PortPinMode = PORT_PIN_MODE_INPUT_DIO
            PortPinModeChangeable = false
            PortPinRbCharacteristicInput = PORT_PIN_CHARACTERISTIC_INPUT_NOPULL
            PortPinRbFeature = PORT_PIN_FEATURE_INPUT_AUTOMOTIVE
            PortPinRbHwConnector = PORT_00_09
        Port_23
          CTO_ST_INH (PortPin):
            PortPinDirection = PORT_PIN_DIRECTION_IN
            PortPinInitialMode = PORT_PIN_MODE_INPUT_DIO
            PortPinLevelValue = PORT_PIN_LEVEL_LOW
            PortPinMode = PORT_PIN_MODE_INPUT_DIO
            PortPinModeChangeable = false
            PortPinRbCharacteristicInput = PORT_PIN_CHARACTERISTIC_INPUT_NOPULL
            PortPinRbFeature = PORT_PIN_FEATURE_INPUT_TTL
            PortPinRbHwConnector = PORT_23_03
  module config rba_IoSigDio
    rba_IoSigDio_General: rba_IoSigDio_DevErrorDetect=true, rba_IoSigDio_RequestHandling=Strict, rba_IoSigDio_ValidationInversion=false, rba_IoSigDio_VersionInfoApi=false
    rba_IoSigDio_ConfigSet
      23 x rba_IoSigDio_Signal, all with rba_IoSigDio_1DirectionChangeable=false, rba_IoSigDio_1Invert=false:
        CTO_AOV: rba_IoSigDio_0CustSpecName=CTO_AOV, rba_IoSigDio_1ConnectedTo=DIO_01_03, rba_IoSigDio_1Direction=Output, rba_IoSigDio_CalibAlterText=CTO_AOV, rba_IoSigDio_Calibratable=false, rba_IoSigDio_InitState=Idle, rba_IoSigDio_InitStrategy=AnyReset, rba_IoSigDio_OutProtectStrategy=SwitchOff
        CTO_RST_INH1: rba_IoSigDio_0CustSpecName=CTO_RST_INH1, rba_IoSigDio_1ConnectedTo=DIO_23_00, rba_IoSigDio_1Direction=Output, rba_IoSigDio_CalibAlterText=CTO_RST_INH1, rba_IoSigDio_Calibratable=false, rba_IoSigDio_InitState=Active, rba_IoSigDio_InitStrategy=AnyReset, rba_IoSigDio_OutProtectStrategy=SwitchOff
        CTO_S7000_LSS_EN: rba_IoSigDio_0CustSpecName=CTO_S7000_LSS_EN, rba_IoSigDio_1ConnectedTo=DIO_20_09, rba_IoSigDio_1Direction=Output, rba_IoSigDio_CalibAlterText=CTO_S7000_LSS_EN, rba_IoSigDio_Calibratable=false, rba_IoSigDio_InitState=Idle, rba_IoSigDio_InitStrategy=AnyReset, rba_IoSigDio_OutProtectStrategy=SwitchOff
        CTO_S7000_LSS_ST: rba_IoSigDio_1ConnectedTo=DIO_20_10, rba_IoSigDio_1Direction=Input, rba_IoSigDio_CalibAlterText=INTERNAL, rba_IoSigDio_InitState=Idle, rba_IoSigDio_InitStrategy=AnyReset
        CTO_ST_INH: rba_IoSigDio_1ConnectedTo=DIO_23_03 if sw-syscond=MDG1CPUVENDOR_SC, rba_IoSigDio_1Direction=Input, rba_IoSigDio_InitState=Idle, rba_IoSigDio_InitStrategy=AnyReset
        CTO_ST_INH1: rba_IoSigDio_1ConnectedTo=DIO_00_10 if sw-syscond=MDG1CPUVENDOR_SC, rba_IoSigDio_1Direction=Input, rba_IoSigDio_CalibAlterText=K22_I_S_DIG1, rba_IoSigDio_Calibratable=true, rba_IoSigDio_CalibratableInvert=true, rba_IoSigDio_InitState=Idle, rba_IoSigDio_InitStrategy=AnyReset
        CTO_ST_INH2: rba_IoSigDio_1ConnectedTo=DIO_00_09 if sw-syscond=MDG1CPUVENDOR_SC, rba_IoSigDio_1Direction=Input, rba_IoSigDio_CalibAlterText=K21_I_S_DIG2, rba_IoSigDio_Calibratable=true, rba_IoSigDio_CalibratableInvert=true, rba_IoSigDio_InitState=Idle, rba_IoSigDio_InitStrategy=AnyReset
        I_S_X10: rba_IoSigDio_0CustSpecName=I_S_X10, rba_IoSigDio_1ConnectedTo=L9966_01_10, rba_IoSigDio_1Direction=Input, rba_IoSigDio_CalibAlterText=K43_I_S_X10, rba_IoSigDio_Calibratable=true, rba_IoSigDio_CalibratableInvert=true
        I_S_X13: rba_IoSigDio_0CustSpecName=I_S_X13, rba_IoSigDio_1ConnectedTo=L9966_01_13, rba_IoSigDio_1Direction=Input, rba_IoSigDio_CalibAlterText=K33_I_S_X13, rba_IoSigDio_Calibratable=true, rba_IoSigDio_CalibratableInvert=true
        I_S_X14: rba_IoSigDio_0CustSpecName=I_S_X14, rba_IoSigDio_1ConnectedTo=L9966_01_14, rba_IoSigDio_1Direction=Input, rba_IoSigDio_CalibAlterText=K32_I_S_X14, rba_IoSigDio_Calibratable=true, rba_IoSigDio_CalibratableInvert=true
        I_S_X15: rba_IoSigDio_0CustSpecName=I_S_X15, rba_IoSigDio_1ConnectedTo=L9966_01_15, rba_IoSigDio_1Direction=Input, rba_IoSigDio_CalibAlterText=K31_I_S_X15, rba_IoSigDio_Calibratable=true, rba_IoSigDio_CalibratableInvert=true
        I_S_X28: rba_IoSigDio_0CustSpecName=I_S_X28, rba_IoSigDio_1ConnectedTo=L9966_02_13, rba_IoSigDio_1Direction=Input, rba_IoSigDio_CalibAlterText=K34_I_S_X28, rba_IoSigDio_Calibratable=true, rba_IoSigDio_CalibratableInvert=true
        I_S_X29: rba_IoSigDio_0CustSpecName=I_S_X29, rba_IoSigDio_1ConnectedTo=L9966_02_14, rba_IoSigDio_1Direction=Input, rba_IoSigDio_CalibAlterText=K35_I_S_X29, rba_IoSigDio_Calibratable=true, rba_IoSigDio_CalibratableInvert=true
        I_S_X30: rba_IoSigDio_0CustSpecName=I_S_X30, rba_IoSigDio_1ConnectedTo=L9966_02_15, rba_IoSigDio_1Direction=Input, rba_IoSigDio_CalibAlterText=K30_I_S_X30, rba_IoSigDio_Calibratable=true, rba_IoSigDio_CalibratableInvert=true
        O_S_RL09: rba_IoSigDio_0CustSpecName=O_S_RL09, rba_IoSigDio_1ConnectedTo=TLE7244_01_05, rba_IoSigDio_1Direction=Output, rba_IoSigDio_CalibAlterText=K84_O_S_RL09, rba_IoSigDio_Calibratable=true, rba_IoSigDio_CalibratableInvert=true, rba_IoSigDio_InitState=Active, rba_IoSigDio_InitStrategy=AnyReset, rba_IoSigDio_OutDiagCurrent=true, rba_IoSigDio_OutProtectStrategy=SwitchOff
          rba_IoSigDio_Diagnosis: rba_IoSigDio_DiagTestPulse=true, rba_IoSigDio_DiagTestPulseDurActive=4, rba_IoSigDio_DiagTestPulseDurIdle=65
        O_S_RL10: rba_IoSigDio_0CustSpecName=O_S_RL10, rba_IoSigDio_1ConnectedTo=TLE7244_01_06, rba_IoSigDio_1Direction=Output, rba_IoSigDio_CalibAlterText=K85_O_S_RL10, rba_IoSigDio_Calibratable=true, rba_IoSigDio_CalibratableInvert=true, rba_IoSigDio_InitState=Active, rba_IoSigDio_InitStrategy=AnyReset, rba_IoSigDio_OutDiagCurrent=true, rba_IoSigDio_OutProtectStrategy=SwitchOff
          rba_IoSigDio_Diagnosis: rba_IoSigDio_DiagTestPulse=true, rba_IoSigDio_DiagTestPulseDurActive=4, rba_IoSigDio_DiagTestPulseDurIdle=65
        O_S_RL11: rba_IoSigDio_0CustSpecName=O_S_RL11, rba_IoSigDio_1ConnectedTo=TLE7244_01_07, rba_IoSigDio_1Direction=Output, rba_IoSigDio_CalibAlterText=K86_O_S_RL11, rba_IoSigDio_Calibratable=true, rba_IoSigDio_CalibratableInvert=true, rba_IoSigDio_InitState=Active, rba_IoSigDio_InitStrategy=AnyReset, rba_IoSigDio_OutDiagCurrent=true, rba_IoSigDio_OutProtectStrategy=SwitchOff
          rba_IoSigDio_Diagnosis: rba_IoSigDio_DiagTestPulse=true, rba_IoSigDio_DiagTestPulseDurActive=4, rba_IoSigDio_DiagTestPulseDurIdle=65
        O_S_RL12: rba_IoSigDio_0CustSpecName=O_S_RL12, rba_IoSigDio_1ConnectedTo=TLE7244_01_08, rba_IoSigDio_1Direction=Output, rba_IoSigDio_CalibAlterText=K87_O_S_RL12, rba_IoSigDio_Calibratable=true, rba_IoSigDio_CalibratableInvert=true, rba_IoSigDio_InitState=Active, rba_IoSigDio_InitStrategy=AnyReset, rba_IoSigDio_OutDiagCurrent=true, rba_IoSigDio_OutProtectStrategy=SwitchOff
          rba_IoSigDio_Diagnosis: rba_IoSigDio_DiagTestPulse=true, rba_IoSigDio_DiagTestPulseDurActive=4, rba_IoSigDio_DiagTestPulseDurIdle=65
        PMD_O_D: rba_IoSigDio_0CustSpecName=PMD_O_D, rba_IoSigDio_1ConnectedTo=NULL_00_01, rba_IoSigDio_1Direction=Output, rba_IoSigDio_InitState=Idle, rba_IoSigDio_InitStrategy=AnyReset, rba_IoSigDio_OutProtectStrategy=SwitchOff
          rba_IoSigDio_Diagnosis: rba_IoSigDio_DiagTestPulse=true, rba_IoSigDio_DiagTestPulseDurActive=250, rba_IoSigDio_DiagTestPulseDurIdle=379
        O_S_RL05: rba_IoSigDio_0CustSpecName=O_S_RL05, rba_IoSigDio_1ConnectedTo=TLE7244_01_01, rba_IoSigDio_1Direction=Output, rba_IoSigDio_CalibAlterText=K80_O_S_RL05, rba_IoSigDio_Calibratable=true, rba_IoSigDio_CalibratableInvert=true, rba_IoSigDio_InitState=Idle, rba_IoSigDio_InitStrategy=AnyReset, rba_IoSigDio_OutDiagCurrent=true, rba_IoSigDio_OutProtectStrategy=SwitchOff
          rba_IoSigDio_Diagnosis:
            rba_IoSigDio_DiagMonitoredCompOther = _anystring_
            rba_IoSigDio_DiagTestPulse = true
            rba_IoSigDio_DiagTestPulseDurActive = 250
            rba_IoSigDio_DiagTestPulseDurIdle = 379
            rba_IoSigDio_DynCreate_RBA_IODIAGPS_OL = Disabled
            rba_IoSigDio_DynCreate_RBA_IODIAGPS_OT = Disabled
            rba_IoSigDio_DynCreate_RBA_IODIAGPS_SCB = Disabled
            rba_IoSigDio_DynCreate_RBA_IODIAGPS_SCG = Disabled
        VDD12SPLY1ENA_O_D: rba_IoSigDio_0CustSpecName=CTO_S3180_INH, rba_IoSigDio_1ConnectedTo=DIO_22_02, rba_IoSigDio_1Direction=Output, rba_IoSigDio_CalibAlterText=CTO_S3180_INH, rba_IoSigDio_Calibratable=false, rba_IoSigDio_CalibratableInvert=false, rba_IoSigDio_InitState=Active, rba_IoSigDio_InitStrategy=AnyReset, rba_IoSigDio_OutProtectStrategy=SwitchOff
        VDD5VSPLY1ENA_O_D: rba_IoSigDio_0CustSpecName=CTO_S3150_EN, rba_IoSigDio_1ConnectedTo=DIO_22_03, rba_IoSigDio_1Direction=Output, rba_IoSigDio_CalibAlterText=CTO_S3150_EN, rba_IoSigDio_Calibratable=false, rba_IoSigDio_CalibratableInvert=false, rba_IoSigDio_InitState=Active, rba_IoSigDio_InitStrategy=AnyReset, rba_IoSigDio_OutProtectStrategy=SwitchOff, variation-point=sw-syscond=SSPMON_5VSPLY1AVL_SC  # ASIC TLE4254GA
        VDD5VSPLY2ENA_O_D: rba_IoSigDio_0CustSpecName=CTO_S3190_EN, rba_IoSigDio_1ConnectedTo=DIO_00_11, rba_IoSigDio_1Direction=Output, rba_IoSigDio_CalibAlterText=CTO_S3190_EN, rba_IoSigDio_Calibratable=false, rba_IoSigDio_CalibratableInvert=false, rba_IoSigDio_InitState=Active, rba_IoSigDio_InitStrategy=AnyReset, rba_IoSigDio_OutProtectStrategy=SwitchOff, variation-point=sw-syscond=SSPMON_5VSPLY2AVL_SC  # ASIC TLE4254GA
    12 x rba_IoSigDio_SignalRequest:
      CTO_AOV: rba_IoSigDio_1Direction=Output, rba_IoSigDio_1DirectionChangeable=false
      I_S_X10: rba_IoSigDio_1Direction=Input
      I_S_X{13..15}: rba_IoSigDio_1Direction=Input
      I_S_X{28..30}: rba_IoSigDio_1Direction=Input
      PMD_O_D: rba_IoSigDio_1Direction=Output, rba_IoSigDio_1DirectionChangeable=false
      O_S_RL05: rba_IoSigDio_1Direction=Output, rba_IoSigDio_1DirectionChangeable=false
      VDD5VSPLY1ENA_O_D: rba_IoSigDio_1Direction=Output, rba_IoSigDio_1DirectionChangeable=false, rba_IoSigDio_Calibratable=false, rba_IoSigDio_Diag=false, rba_IoSigDio_InitState=Active, rba_IoSigDio_InitStrategy=AnyReset, rba_IoSigDio_OutProtectStrategy=SwitchOff, variation-point=sw-syscond=SSPMON_5VSPLY1AVL_SC
      VDD5VSPLY2ENA_O_D: rba_IoSigDio_1Direction=Output, rba_IoSigDio_1DirectionChangeable=false, rba_IoSigDio_Calibratable=false, rba_IoSigDio_Diag=false, rba_IoSigDio_InitState=Active, rba_IoSigDio_InitStrategy=AnyReset, rba_IoSigDio_OutProtectStrategy=SwitchOff, variation-point=sw-syscond=SSPMON_5VSPLY2AVL_SC
    ADC (rba_IoSigDio_Device):
      rba_IoSigDio_DeviceCompName = rba_IoSigDio_DioOverAdc
      rba_IoSigDio_DeviceDescName = rba_IoSigDio_DioOverAdcInterface_cst
      rba_IoSigDio_DeviceHeader = rba_IoSigDio_DioOverAdc.h
