AUTOSAR XML (schema 4-0-2)
package /RB/UBK/Project/EcucModuleConfigurationValuess
  module config rba_IoSigDio
    rba_IoSigDio_General: rba_IoSigDio_DevErrorDetect=true, rba_IoSigDio_RequestHandling=Strict, rba_IoSigDio_ValidationInversion=false, rba_IoSigDio_VersionInfoApi=false
    rba_IoSigDio_ConfigSet: sub-containers={{SIGNAL_CONTAINERS}}
