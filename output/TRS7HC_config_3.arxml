AUTOSAR XML (schema 4-0-2)
package /RB/UBK/Project/EcucModuleConfigurationValuess
  module config rba_IoSigDio
    rba_IoSigDio_General: rba_IoSigDio_DevErrorDetect=true, rba_IoSigDio_RequestHandling=Strict, rba_IoSigDio_ValidationInversion=false, rba_IoSigDio_VersionInfoApi=false
    rba_IoSigDio_ConfigSet
      TRS7HC (rba_IoSigDio_Signal):
        rba_IoSigDio_0CustSpecName = DIO_01_01
        rba_IoSigDio_1ConnectedTo = TLE7244_01_01
        rba_IoSigDio_1Direction = Output
        rba_IoSigDio_1DirectionChangeable = true
        rba_IoSigDio_1Invert = true
        rba_IoSigDio_CalibAlterText = K80_TRS7HC
        rba_IoSigDio_Calibratable = true
        rba_IoSigDio_CalibratableInvert = true
        rba_IoSigDio_InitState = Low
        rba_IoSigDio_InitStrategy = OnRequest
        rba_IoSigDio_OutDiagCurrent = true
        rba_IoSigDio_OutProtectStrategy = Standard
    TRS7HC (rba_IoSigDio_SignalRequest):
      rba_IoSigDio_1Direction = Output
      rba_IoSigDio_1DirectionChangeable = true
      rba_IoSigDio_Calibratable = true
      rba_IoSigDio_Diag = true
      rba_IoSigDio_InitState = Low
      rba_IoSigDio_InitStrategy = OnRequest
      rba_IoSigDio_OutProtectStrategy = Standard
