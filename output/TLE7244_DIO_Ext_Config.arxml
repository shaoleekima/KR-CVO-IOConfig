AUTOSAR XML (schema 4-1-1)
package /RB/UBK/Project/EcucModuleConfigurationValuess
  module config rba_IoExtTle7244
    rba_IoExtTle7244_General:
      rba_IoExtTle7244_DevErrorDetect = true
      rba_IoExtTle7244_DiagApi = true
      rba_IoExtTle7244_DioApi = true
      rba_IoExtTle7244_PwmApi = true
      rba_IoExtTle7244_VersionInfoApi = true
    rba_IoExtTle7244_ConfigSet
      trs7hc (rba_IoExtTle7244_SignalDio): rba_IoExtTle7244_ConnectedTo=DIO_10_00
