AUTOSAR XML (schema 4-0-2)
package /RB/UBK/Project/EcucModuleConfigurationValuess
  module config Port
    PortConfigSet
  module config rba_IoSigDio
    rba_IoSigDio_General: rba_IoSigDio_DevErrorDetect=true, rba_IoSigDio_RequestHandling=Strict, rba_IoSigDio_ValidationInversion=false, rba_IoSigDio_VersionInfoApi=false
    rba_IoSigDio_ConfigSet
      O_S_RL05 (rba_IoSigDio_Signal):
        rba_IoSigDio_0CustSpecName = O_S_RL05
        rba_IoSigDio_1ConnectedTo = TLE7244_01_01
        rba_IoSigDio_1Direction = Output
        rba_IoSigDio_1DirectionChangeable = false
        rba_IoSigDio_1Invert = false
        rba_IoSigDio_CalibAlterText = K80_O_S_RL05
        rba_IoSigDio_Calibratable = true
        rba_IoSigDio_CalibratableInvert = true
        rba_IoSigDio_InitState = Idle
        rba_IoSigDio_InitStrategy = AnyReset
        rba_IoSigDio_OutDiagCurrent = true
        rba_IoSigDio_OutProtectStrategy = SwitchOff
        rba_IoSigDio_Diagnosis:
          rba_IoSigDio_DiagMonitoredCompOther = _anystring_
          rba_IoSigDio_DiagTestPulse = true
          rba_IoSigDio_DiagTestPulseDurActive = 250
          rba_IoSigDio_DiagTestPulseDurIdle = 379
          rba_IoSigDio_DynCreate_RBA_IODIAGPS_OL = Disabled
          rba_IoSigDio_DynCreate_RBA_IODIAGPS_OT = Disabled
          rba_IoSigDio_DynCreate_RBA_IODIAGPS_SCB = Disabled
          rba_IoSigDio_DynCreate_RBA_IODIAGPS_SCG = Disabled
    O_S_RL05 (rba_IoSigDio_SignalRequest): rba_IoSigDio_1Direction=Output, rba_IoSigDio_1DirectionChangeable=false
