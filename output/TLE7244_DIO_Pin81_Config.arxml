AUTOSAR XML (schema 4-0-2)
package /RB/UBK/Project/EcucModuleConfigurationValuess
  module config rba_IoSigDio
    rba_IoSigDio_General: rba_IoSigDio_DevErrorDetect=true, rba_IoSigDio_RequestHandling=Strict, rba_IoSigDio_ValidationInversion=false, rba_IoSigDio_VersionInfoApi=false
    rba_IoSigDio_ConfigSet
      TRS7HC (rba_IoSigDio_Signal):
        rba_IoSigDio_0CustSpecName = TRS7HC
        rba_IoSigDio_1ConnectedTo = TLE7244_01_02
        rba_IoSigDio_1Direction = Output
        rba_IoSigDio_1DirectionChangeable = false
        rba_IoSigDio_1Invert = false
        rba_IoSigDio_CalibAlterText = 
        rba_IoSigDio_Calibratable = false
        rba_IoSigDio_CalibratableInvert = false
        rba_IoSigDio_InitState = Idle
        rba_IoSigDio_InitStrategy = AnyReset
        rba_IoSigDio_OutDiagCurrent = false
        rba_IoSigDio_OutProtectStrategy = SwitchOff
        rba_IoSigDio_Diagnosis:
          rba_IoSigDio_DiagMonitoredCompOther = _anystring_
          rba_IoSigDio_DiagTestPulse = true
          rba_IoSigDio_DiagTestPulseDurActive = 250
          rba_IoSigDio_DiagTestPulseDurIdle = 379
          rba_IoSigDio_DynCreate_RBA_IODIAGPS_OL = Disabled
          rba_IoSigDio_DynCreate_RBA_IODIAGPS_OT = Disabled
          rba_IoSigDio_DynCreate_RBA_IODIAGPS_SCB = Disabled
          rba_IoSigDio_DynCreate_RBA_IODIAGPS_SCG = Disabled
    TRS7HC (rba_IoSigDio_SignalRequest):
      rba_IoSigDio_1Direction = Output
      rba_IoSigDio_1DirectionChangeable = false
      rba_IoSigDio_Calibratable = false
      rba_IoSigDio_Diag = false
      rba_IoSigDio_InitState = Idle
      rba_IoSigDio_InitStrategy = AnyReset
      rba_IoSigDio_OutProtectStrategy = SwitchOff
